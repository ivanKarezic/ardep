## boards/riverdi/riverdi_70stm32h7/Kconfig.riverdi_70stm32h7
```kconfig
# SPDX-License-Identifier: Apache-2.0

config BOARD_RIVERDI_70STM32H7
	select SOC_STM32H757XX_M7 if BOARD_RIVERDI_70STM32H7_STM32H757XX_M7
```

## boards/riverdi/riverdi_70stm32h7/board.yml
```yaml
board:
  name: riverdi_70stm32h7
  full_name: Riverdi 7-inch STM32H7 Display (RVT70HSSNWC00-B)
  vendor: riverdi
  socs:
    - name: stm32h757xx
```

## boards/st/stm32h7b3i_eval/Kconfig.defconfig
```kconfig
# SPDX-License-Identifier: Apache-2.0

if BOARD_STM32H7B3I_EVAL

config CAN_TRANSCEIVER_INIT_PRIORITY
	default 75

endif
```

## boards/st/stm32h7b3i_eval/Kconfig.stm32h7b3i_eval
```kconfig
# SPDX-License-Identifier: Apache-2.0

config BOARD_STM32H7B3I_EVAL
	select SOC_STM32H7B3XXQ
```

## boards/st/stm32h7b3i_eval/board.yml
```yaml
board:
  name: stm32h7b3i_eval
  full_name: STM32H7B3I Evaluation Kit (MB1370-LCD-B02)
  vendor: st
  socs:
    - name: stm32h7b3xx
```

## dts/bindings/display/riverdi,charger-io.yaml
```yaml
description: Riverdi display and touch control lines
compatible: "riverdi,charger-io"
include: base.yaml
properties:
  panel-reset-gpios:
    type: phandle-array
    required: true
  pwms:
    type: phandle-array
    required: true
  touch-reset-gpios:
    type: phandle-array
    required: true
  touch-int-gpios:
    type: phandle-array
    required: true
```

## dts/bindings/display/riverdi,rvt70-panel.yaml
```yaml
description: Riverdi RVT70 MIPI DSI panel
compatible: "riverdi,rvt70-panel"
include: mipi-dsi-device.yaml
```

## samples/riverdi_charger/src/pm_control/Kconfig
```kconfig
menu "Power Module Control"

module = PM_CONTROL
module-str = pm_control
source "subsys/logging/Kconfig.template.log_config"

config PM_CONTROL_INIT_PRIORITY
    int "Initialization priority"
    default APPLICATION_INIT_PRIORITY
    help
      Initialization priority for the power module control.

config PM_CONTROL_NUM_POWER_MODULES
    int "Number of power modules"
    default 1
    help
      Number of power modules to control.

config PM_CONTROL_POWER_UP_DELAY_MS
    int "Power up delay in milliseconds"
    default 3000
    help
      Delay after power up before starting the message transmit.

config PM_CONTROL_CAN_TRANSMIT_TIMEOUT_MS
    int "CAN transmit timeout in milliseconds"
    default 100
    help
      Timeout for CAN message transmission.

config PM_CONTROL_PDO_PERIOD_MS
    int "PDO period in milliseconds"
    default 10
    help
      Period with which the PDO is sent.

config PM_CONTROL_HB_PERIOD_MS
    int "Heartbeat period in milliseconds"
    default 100
    help
      Period with which the heartbeat is sent.

config PM_CONTROL_SYNC_PERIOD_MS
    int "SYNC period in milliseconds"
    default 10
    help
      Period with which the SYNC is sent.

endmenu
```
